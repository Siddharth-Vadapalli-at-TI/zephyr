## CMakeLists.txt
```
# SPDX-License-Identifier: Apache-2.0

cmake_minimum_required(VERSION 3.20.0)
find_package(Zephyr REQUIRED HINTS $ENV{ZEPHYR_BASE})
project(ti_am62l_evm_cpsw_ethernet)

FILE(GLOB app_sources src/*.c)
target_sources(app PRIVATE ${app_sources})
```

## prj.conf
```kconfig
# DMA for CPSW
CONFIG_DMA=y

# Network support
CONFIG_NETWORKING=y
CONFIG_NET_BUF_DATA_SIZE=1520
CONFIG_NET_DHCPV4=y
CONFIG_NET_IPV4=y
CONFIG_NET_L2_ETHERNET=y
CONFIG_NET_UDP=y
CONFIG_NET_TCP=y

# IPv4 and IPv6 slots for two MAC Ports of CPSW3G
CONFIG_NET_IF_MAX_IPV4_COUNT=2
CONFIG_NET_IF_MAX_IPV6_COUNT=2

# Logging for Ethernet events
CONFIG_LOG=y
CONFIG_LOG_DEFAULT_LEVEL=2
CONFIG_ETHERNET_LOG_LEVEL_INF=y

# Network management events
CONFIG_NET_MGMT=y
CONFIG_NET_MGMT_EVENT=y

# Network performance measuring utility
CONFIG_NET_ZPERF=y

# Packet and buffer pool sizes
CONFIG_NET_PKT_RX_COUNT=40
CONFIG_NET_PKT_TX_COUNT=40
CONFIG_NET_BUF_RX_COUNT=160
CONFIG_NET_BUF_TX_COUNT=160

# Interactive shell with network and register-access commands
CONFIG_SHELL=y
CONFIG_DEVMEM_SHELL=y
CONFIG_NET_SHELL=y

# Default KERNEL_VM_SIZE of 2 MB is insufficient
CONFIG_KERNEL_VM_SIZE=0x1000000

# Since 14 XLAT_TABLES are used by this sample, the default
# MAX_XLAT_TABLES value of 16 throws a warning.
# Increase it to 20 to future-proof the sample, since other
# peripherals may be added to the board later on and could
# require more tables.
CONFIG_MAX_XLAT_TABLES=20
```

## src/main.c
```c
/* TI AM62L EVM CPSW Ethernet Sample
 *
 * Copyright (c) 2026 Texas Instruments Incorporated
 * Author: Siddharth Vadapalli <s-vadapalli@ti.com>
 *
 * SPDX-License-Identifier: Apache-2.0
 */

#include <zephyr/logging/log.h>

LOG_MODULE_REGISTER(cpsw_ethernet, LOG_LEVEL_INF);

int main(void)
{
	LOG_INF("CPSW Ethernet sample application");

	return 0;
}
```
