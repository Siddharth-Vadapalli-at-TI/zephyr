## dts/bindings/mdio/ti,am62l-cpsw-mdio.yaml
```yaml
# Copyright (c) 2026 Texas Instruments Incorporated
# Author: Siddharth Vadapalli <s-vadapalli@ti.com>
# SPDX-License-Identifier: Apache-2.0

description: TI AM62L CPSW MDIO controller

compatible: "ti,am62l-cpsw-mdio"

include: [mdio-controller.yaml]

properties:
  reg:
    required: true
    description: |
      MDIO Controller register offset from CPSW Base Address.

  clock-names:
    required: true
    description: |
      Clock name "fck" to indicate the functional clock for the
      MDIO Controller.
```

## dts/bindings/otp/ti,am62l-cpsw-mac-efuse.yaml
```yaml
# Copyright (c) 2026 Texas Instruments Incorporated
# Author: Siddharth Vadapalli <s-vadapalli@ti.com>
# SPDX-License-Identifier: Apache-2.0

description: TI AM62L CPSW MAC Address eFuse block

compatible: "ti,am62l-cpsw-mac-efuse"

properties:
  reg:
    required: true
    type: array

child-binding:
  description: NVMEM cell identifying the 6-byte MAC address byte range.

  include: fixed-layout.yaml
```

## dts/bindings/phy/ti,am62l-phy-gmii-sel.yaml
```yaml
# Copyright (c) 2026 Texas Instruments Incorporated
# Author: Siddharth Vadapalli <s-vadapalli@ti.com>
# SPDX-License-Identifier: Apache-2.0

description: TI AM62L CPSW MAC Port GMII (PHY) selection block

compatible: "ti,am62l-phy-gmii-sel"

include: phy-controller.yaml

properties:
  reg:
    required: true
    description: |
      The CTRL MMR register for configuring the GMII block of the first
      CPSW MAC Port. The registers for the second MAC Port and upwards
      are offset by 0x4.

  "#phy-cells":
    const: 0
```
